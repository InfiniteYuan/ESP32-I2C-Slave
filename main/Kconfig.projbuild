## main/Kconfig.projbuild
```kconfig
menu "ESP32 I2C Slave Example Configuration"

config I2C_SLAVE_ADDRESS
    hex "ESP Slave Address"
    default 0x28
    help
        Hardware Address of I2C Slave Port.

choice EXAMPLE_I2C_MODE
    prompt "Choose I2C Mode"
    default EXAMPLE_I2C_MASTER
    
    config EXAMPLE_I2C_SLAVE
        bool "I2C Slave"

    config EXAMPLE_I2C_MASTER
        bool "I2C Master"

endchoice

menu "I2C Master"
    depends on EXAMPLE_I2C_MASTER

    config I2C_MASTER_SCL
        int "SCL GPIO Num"
        default 5
        help
            GPIO number for I2C Master clock line.

    config I2C_MASTER_SDA
        int "SDA GPIO Num"
        default 4
        help
            GPIO number for I2C Master data line.

    config I2C_MASTER_PORT_NUM
        int "Port Number"
        default 1
        help
            Port number for I2C Master device.

    config I2C_MASTER_FREQUENCY
        int "Master Frequency"
        default 100000
        help
            I2C Speed of Master device.
endmenu

menu "I2C Slave"
    depends on EXAMPLE_I2C_SLAVE

    config I2C_SLAVE_SCL
        int "SCL GPIO Num"
        default 5
        help
            GPIO number for I2C Slave clock line.

    config I2C_SLAVE_SDA
        int "SDA GPIO Num"
        default 4
        help
            GPIO number for I2C Slave data line.

    config I2C_SLAVE_PORT_NUM
        int "Port Number"
        default 0
        help
            Port number for I2C Slave device.
endmenu

endmenu
```
